#include <SPI.h>
#include <Wire.h>
#include <Adafruit_GFX.h>
#include <Adafruit_SSD1306.h>
#include <LoRa.h>
#include "BluetoothSerial.h"

// Constants for distance calculation
const float A = 0.14249221769081155;
const float B = 5.955924769800823;
const float C = 1.12026988449282;
const int t = -40; 

// LoRa Image Bitmap (truncated for brevity)
#define logo_width 99
#define logo_height 64

const uint8_t logo_bits[] PROGMEM = {
  0x00, 0x00, 0x00, 0x00, 0x00, 0x00, 0x00, 0x00, 0x00, 0x00, 0x00, 0x00, 
  0x00, 0x00, 0x00, 0x00, 0x00, 0x00, 0x00, 0x00, 0x00, 0x00, 0x00, 0x00, 
  0x00, 0x00, 0x00, 0x00, 0x00, 0x00, 0x00, 0x00, 0x00, 0x00, 0x00, 0x00, 
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  0x00, 0x00, 0x00, 0x00,
};

#define LORA_BAND     915

#define OLED_SDA    4
#define OLED_SCL    15
#define OLED_RST    16

#define SCK 5   // GPIO5  -- SX1278's SCK
#define MISO 19 // GPIO19 -- SX1278's MISO
#define MOSI 27 // GPIO27 -- SX1278's MOSI
#define SS 18   // GPIO18 -- SX1278's CS
#define RST 14  // GPIO14 -- SX1278's RESET
#define DI0 26  // GPIO26 -- SX1278's IRQ(Interrupt Request)

#if !defined(CONFIG_BT_ENABLED) || !defined(CONFIG_BLUEDROID_ENABLED)
#error Bluetooth is not enabled! Please run `make menuconfig` to and enable it
#endif

Adafruit_SSD1306 display(128, 64, &Wire, OLED_RST);
BluetoothSerial SerialBT;

#define NODE_ID 4 // Assign a unique ID for each node

// Function Prototypes
void showLogo();
void displayLoraData(int packetSize, String packet, String rssi, String distanceStr);
float calculateDistance(int rssi);

void showLogo() {
  uint8_t x_off = (display.width() - logo_width) / 2;
  uint8_t y_off = (display.height() - logo_height) / 2;

  display.clearDisplay();
  display.drawBitmap(x_off, y_off, logo_bits, logo_width, logo_height, SSD1306_WHITE);
  display.display();
}

void setup() {
  Serial.begin(115200);
  while (!Serial);
  Serial.println();
  Serial.println("LoRa Relay Node 3");

  SerialBT.begin("LoRaRelay"); // Bluetooth device name
  Serial.println("The device started, now you can pair it with Bluetooth!");

  // Configure OLED by setting the OLED Reset HIGH, LOW, and then back HIGH
  pinMode(OLED_RST, OUTPUT);
  digitalWrite(OLED_RST, HIGH);
  delay(100);
  digitalWrite(OLED_RST, LOW);
  delay(100);
  digitalWrite(OLED_RST, HIGH);

  if (!display.begin(SSD1306_SWITCHCAPVCC, 0x3C)) { 
    Serial.println(F("SSD1306 allocation failed"));
    for (;;);
  }

  showLogo();
  delay(2000);

  display.clearDisplay();
  display.setTextSize(1);
  display.setTextColor(SSD1306_WHITE);
  display.setCursor(0, 10);
  display.println(F("LoRa Relay 3"));
  display.display();
  delay(2000);

  // Configure the LoRa radio
  SPI.begin(SCK, MISO, MOSI, SS);
  LoRa.setPins(SS, RST, DI0);
  if (!LoRa.begin(LORA_BAND * 1E6)) {
    Serial.println("Starting LoRa failed!");
    while (1);
  }
  Serial.println("LoRa Initializing OK!");

  // Set spreading factor to 12 (max range)
  LoRa.setSpreadingFactor(12);

  // Set signal bandwidth to 125 kHz (default, suitable for long range)
  LoRa.setSignalBandwidth(125E3);

  // Set coding rate to 4/8 (default)
  LoRa.setCodingRate4(8);

  // Set the output power to max (20 dBm)
  LoRa.setTxPower(20);

  // Set the radio into receive mode
  LoRa.receive();
  delay(1500);
}

void loop() {
  int packetSize = LoRa.parsePacket();
  if (packetSize) {
    String packet = "";
    for (int i = 0; i < packetSize; i++) {
      packet += (char)LoRa.read();
    }
    String rssi = "RSSI " + String(LoRa.packetRssi(), DEC);
    Serial.println(rssi);

    float distance = calculateDistance(LoRa.packetRssi());
    String distanceStr = String(distance, 2); 
    displayLoraData(packetSize, packet, rssi, distanceStr);

    SerialBT.print(packetSize);
    SerialBT.print("  ");
    SerialBT.print(packet);
    SerialBT.print("  ");
    SerialBT.println(rssi);    
  }
  delay(10);
}

void displayLoraData(int packetSize, String packet, String rssi, String distanceStr) {
  String packSize = String(packetSize, DEC);
  display.clearDisplay(); 
  display.setTextSize(1);
  display.setTextColor(SSD1306_WHITE);

  display.setCursor(0, 0);
  display.println(rssi);
  display.setCursor(0, 10);
  display.println("Received " + packSize + " bytes");
  display.setCursor(0, 20);
  display.println(packet);

  
  display.setCursor(0, 30);
  display.print("Estimated Distance: ");
  display.println(distanceStr + " m"); 

  display.println("Relaying Packet");
  display.display();
}

float calculateDistance(int rssi) {
  
  float ratio = (float)rssi / t;
  if (ratio <= 0) {
    return -1.0; 
  }
  float distance = A * pow(ratio, B) + C;
  return distance;
}
